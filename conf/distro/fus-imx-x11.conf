## conf/distro/fus-imx-x11.conf
```bitbake
# i.MX DISTRO for X11 with no wayland

# If we just set our preferred providers for kernel and u-boot in the
# machine files, they are overwritten by the NXP distro files later.
# So we define our own distros, similar to NXP, include NXP's settings
# first (in meta-fsl-bsp-release/imx/meta-sdk/conf/distro/include) and
# then include our settings later (in meta-fus/conf/distro/include),
# where we can override any NXP settings we need.

include conf/distro/fsl-imx-x11.conf
include conf/distro/include/fus-common.inc
```

## conf/distro/include/fus-common.inc
```bitbake
# Common settings for all F&S boards

UBOOT_ENTRYPOINT = "0x80800000"
UBOOT_ENTRYPOINT_mx6 = "0x10800000"
UBOOT_ENTRYPOINT_mx6sx = "0x80800000"
UBOOT_ENTRYPOINT_mx6ul = "0x80800000"

PREFERRED_PROVIDER_u-boot_mx6 = "u-boot-fus"
PREFERRED_PROVIDER_u-boot_mx6ul = "u-boot-fus"
PREFERRED_PROVIDER_u-boot_mx6sx = "u-boot-fus"

PREFERRED_PROVIDER_virtual/bootloader_mx6 = "u-boot-fus"
PREFERRED_PROVIDER_virtual/bootloader_mx6ul = "u-boot-fus"
PREFERRED_PROVIDER_virtual/bootloader_mx6sx = "u-boot-fus"

PREFERRED_PROVIDER_virtual/kernel_mx6 = "linux-fus"
PREFERRED_PROVIDER_virtual/kernel_mx6ul = "linux-fus"
PREFERRED_PROVIDER_virtual/kernel_mx6sx = "linux-fus"

IMAGE_FSTYPES = "ubifs ext3 sdcard"
MKUBIFS_ARGS = "-m 2048 -e 126976 -c 2048"

# Remove image_types_fsl because there is a awk command which search after a
# point(.) in the devicetrees. But we have 2 points in the devicetree 
# picocom1.2.dtb so the awk command find the first point, so the new name is
# picocom1 instead of picocom1.2. And thats why you get an error at compile 
# time. Thats why we copy the image_types_fsl and rename it as image_types_fus
# and changed the line in the original file from
# "DTS_BASE_NAME=`basename ${DTS_FILE} | awk -F "." '{print $1}'`" to
# "DTS_BASE_NAME=`basename ${DTS_FILE} | awk -F ".dtb" '{print $1}'`"
# The Original file will be find in sources/meta-fsl-arm/classes/
# image_types_fsl.bbclass
IMAGE_CLASSES_remove = "image_types_fsl"
IMAGE_CLASSES += "image_types_fus"
```

## conf/layer.conf
```bitbake
# We have a conf and classes directory, add to BBPATH
BBPATH .= ":${LAYERDIR}"

# We have recipes-* directories, add to BBFILES
BBFILES += "${LAYERDIR}/recipes-*/*/*.bb \
            ${LAYERDIR}/recipes-*/*/*.bbappend"

BBFILE_COLLECTIONS += "fus fsvybrid"
BBFILE_PATTERN_fus = "^${LAYERDIR}/"
BBFILE_PRIORITY_fus = "5"
#LAYERVERSION_fus = "1"

BBFILE_PATTERN_fsvybrid = "^${LAYERDIR}/"
BBFILE_PRIORITY_fsvybrid = "5"
LAYERVERSION_fsvybrid = "1"
```

## conf/machine/armstonea5.conf
```bitbake
#@TYPE: Machine
#@NAME: F&S armStoneA5
#@SOC: vf60
#@DESCRIPTION: Machine configuration for F&S armStoneA5
#@MAINTAINER: Hartmut Keller <keller@fs-net.de>

UBOOT_SUFFIX ?= "nb0"
IMAGE_FSTYPES ?= "ubifs ext3 sdcard"

require conf/machine/include/imx-base.inc
require conf/machine/include/tune-cortexa5.inc

SOC_FAMILY = "vf60"

PREFERRED_PROVIDER_virtual/kernel ?= "linux-fsvybrid"

PREFERRED_PROVIDER_u-boot = "u-boot-fsvybrid"
PREFERRED_PROVIDER_virtual/bootloader = "u-boot-fsvybrid"

UBOOT_MACHINE = "fsvybrid_config"
MKUBIFS_ARGS = "-m 2048 -e 126976 -c 2048"

SDCARD_ROOTFS ?= "${DEPLOY_DIR_IMAGE}/${IMAGE_NAME}.rootfs.ext3"
#IMAGE_FSTYPES ?= "ubi ext3 sdcard"
#IMAGE_FSTYPES ?= "ubifs ext3"

SERIAL_CONSOLE = "115200 ttymxc1"

MACHINE_FEATURES = "apm usbgadget usbhost vfat alsa touchscreen"

#KERNEL_DEVICETREE = "imx6dl-sabresd.dtb imx6dl-sabresd-ldo.dtb"
```

## conf/machine/fsimx6.conf
```bitbake
#@TYPE: Machine
#@NAME: fsimx6
#@SOC: i.MX6
#@DESCRIPTION: Machine configuration for F&S boards with i.MX6 DualLite/Solo/Dual/Quad
#@MAINTAINER: Hartmut Keller <keller@fs-net.de>

UBOOT_SUFFIX ?= "nb0"

require conf/machine/include/imx-base.inc
require conf/machine/include/tune-cortexa9.inc

SOC_FAMILY = "mx6:mx6dl:mx6q"

KERNEL_IMAGETYPE = "uImage"

### TODO: set to login-tty
SERIAL_CONSOLE = "115200 ttymxc1"
#SERIAL_CONSOLE = "115200 ttymxc0"

# When available, add: qblissa9dl qblissa9q qblissa9r2dl qblissa9r2q
KERNEL_DEVICETREE = "armstonea9dl.dtb armstonea9q.dtb armstonea9r2dl.dtb armstonea9r2q.dtb efusa9dl.dtb efusa9q.dtb picomoda9dl.dtb picomoda9q.dtb netdcua9dl.dtb netdcua9q.dtb"

SDCARD_ROOTFS ?= "${DEPLOY_DIR_IMAGE}/${IMAGE_NAME}.rootfs.ext3"

UBOOT_CONFIG ??= "ubifs"
UBOOT_CONFIG[ubifs] = "fsimx6_config"
UBOOT_CONFIG[sd] = "fsimx6_config,sdcard"
UBOOT_CONFIG[mfgtool] = "fsimx6_config,mfgtool"
```

## conf/machine/fsimx6sx.conf
```bitbake
#@TYPE: Machine
#@NAME: fsimx6sx
#@SOC: i.MX6SX
#@DESCRIPTION: Machine configuration for F&S boards with i.MX6 SoloX
#@MAINTAINER: Hartmut Keller <keller@fs-net.de>

UBOOT_SUFFIX ?= "nb0"

include conf/machine/include/imx-base.inc
include conf/machine/include/tune-cortexa9.inc

SOC_FAMILY = "mx6:mx6sx"

KERNEL_IMAGETYPE = "uImage"

### TODO: set to login-tty
SERIAL_CONSOLE = "115200 ttymxc0"

KERNEL_DEVICETREE = "efusa9x.dtb picocoma9x.dtb"

SDCARD_ROOTFS ?= "${DEPLOY_DIR_IMAGE}/${IMAGE_NAME}.rootfs.ext3"

UBOOT_CONFIG ??= "ubifs"
UBOOT_CONFIG[ubifs] = "fsimx6sx_config"
UBOOT_CONFIG[sd] = "fsimx6sx_config,sdcard"
UBOOT_CONFIG[mfgtool] = "fsimx6sx_config,mfgtool"
```

## conf/machine/fsimx6ul.conf
```bitbake
#@TYPE: Machine
#@NAME: fsimx6ul
#@SOC: i.MX6UL
#@DESCRIPTION: Machine configuration for F&S boards with i.MX6 UltraLite
#@MAINTAINER: Hartmut Keller <keller@fs-net.de>

UBOOT_SUFFIX ?= "nb0"
IMAGE_FSTYPES ?= "ubifs ext3 sdcard"

include conf/machine/include/imx-base.inc
include conf/machine/include/tune-cortexa7.inc

# Do not include conf/machine/include/imx6ul-common.inc as it adds values to
# MACHINE_FEATURES and MACHINE_FIRMWARE that we do not want here. So add the
# stuff from imx6ul-common.inc that we actually need here.
DEFAULTTUNE_mx6ul ?= "cortexa7hf-neon"

MACHINE_SOCARCH_SUFFIX_mx6ul = "-mx6ul"

XSERVER_DRIVER_mx6ul = "xf86-video-fbdev"

PREFERRED_PROVIDER_virtual/egl_mx6ul = "mesa"
PREFERRED_PROVIDER_virtual/libgles1_mx6ul = "mesa"
PREFERRED_PROVIDER_virtual/libgles2_mx6ul = "mesa"
PREFERRED_PROVIDER_virtual/libgl_mx6ul = "mesa"
PREFERRED_PROVIDER_virtual/libg2d_mx6ul = ""

MACHINE_SOCARCH_FILTER_mx6ul = "imx-codec imx-parser gst-fsl-plugins"

# end of imx6ul-common.inc

SOC_FAMILY = "mx6ul"

KERNEL_IMAGETYPE = "uImage"

### TODO: set to login-tty
SERIAL_CONSOLE = "115200 ttymxc0"

KERNEL_DEVICETREE = "efusa7ul.dtb picocom1.2.dtb"

SDCARD_ROOTFS ?= "${DEPLOY_DIR_IMAGE}/${IMAGE_NAME}.rootfs.ext3"

UBOOT_CONFIG ??= "ubifs"
UBOOT_CONFIG[ubifs] = "fsimx6ul_config"
UBOOT_CONFIG[sd] = "fsimx6ul_config,sdcard"
UBOOT_CONFIG[mfgtool] = "fsimx6ul_config,mfgtool"
```
